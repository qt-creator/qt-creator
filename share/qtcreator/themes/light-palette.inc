[Palette]
PaletteWindow=ffffffff
PaletteWindowDisabled=ffececec
PaletteWindowText=ff000000
PaletteWindowTextDisabled=PaletteTextDisabled
PaletteBase=PaletteWindow
PaletteBaseDisabled=PaletteWindowDisabled
PaletteAlternateBase=fff7f7f7
;PaletteAlternateBaseDisabled
PaletteToolTipBase=PaletteDark
;PaletteToolTipBaseDisabled
PaletteToolTipText=PaletteWindowText
;PaletteToolTipTextDisabled
PaletteText=PaletteWindowText
PaletteTextDisabled=55000000
PaletteButton=PaletteDark
;PaletteButtonDisabled
PaletteButtonText=PaletteWindowText
PaletteButtonTextDisabled=PaletteTextDisabled
PaletteBrightText=ffffffff
;PaletteBrightTextDisabled
PaletteHighlight=ffa5cdff
;PaletteHighlightDisabled
PaletteHighlightedText=ff000000
;PaletteHighlightedTextDisabled
PaletteLink=ff0000ff
;PaletteLinkDisabled
PaletteLinkVisited=ff800080
;PaletteLinkVisitedDisabled
;PaletteLight
;PaletteLightDisabled
;PaletteMidlight
;PaletteMidlightDisabled
PaletteDark=ffe4e4e4
;PaletteDarkDisabled
PaletteMid=ffa9a9a9
;PaletteMidDisabled
;PaletteShadow
;PaletteShadowDisabled
PalettePlaceholderText=3f000000
;PalettePlaceholderTextDisabled
