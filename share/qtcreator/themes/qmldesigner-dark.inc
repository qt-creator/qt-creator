[General]
Includes=ds.tokenmapping

[Colors]
;DS controls theme

;NEW FOR QtDS 4
;4.0
DScontrolBackground_toolbarIdle=ff333333
DScontrolBackground_toolbarHover=ff333333
DScontrolBackground_topToolbarHover=ff434343
DScontrolBackground_statusbarIdle=ff202020
DSControlBackground_statusbarHover=ff2a2a2a
DScontrolOutline_topToolbarIdle=ff2a2a2a
DScontrolOutline_topToolbarHover=ff4d4d4d
DSidleGreen=ff649a5d
DSrunningGreen=ff2eff68
DStoolbarBackground=ff333333
DStoolbarIcon_blocked=ff636363
DSthumbnailBackground_baseState=ff1b1b1b
DStextColor=ffdfdfdf
DSstatusbarBackground=ff202020
DSprimaryButton_hoverHighlight=ff74CBFC
DSstateBackgroundColor_hover=ff434343
DSstateControlBackgroundColor_globalHover=ff434343
DSstateControlBackgroundColor_hover=ff4d4d4d
DSpanelBackground=ff2a2a2a

;4.3
DSpopoutBackground=ff202020
DSpopoutControlBackground_idle=ff202020
DSpopoutControlBackground_hover=ff2a2a2a
DSpopoutControlBackground_globalHover=ff2a2a2a
DSpopoutControlBackground_interaction=ff57b9fc
DSpopoutControlBackground_disabled=ff202020
DSpopoutPopupBackground=ff1b1b1b

DSpopoutControlBorder_idle=ff333333
DSpopoutControlBorder_hover=ff4d4d4d
DSpopoutControlBorder_interaction=ff57b9fc
DSpopoutControlBorder_disabled=ff202020

DSpopoutButtonBackground_idle=ff202020
DSpopoutButtonBackground_hover=ff2a2a2a
DSpopoutButtonBackground_interaction=ff57b9fc
DSpopoutButtonBackground_disabled=ff202020

DSpopoutButtonBorder_idle=ff8d8d8d
DSpopoutButtonBorder_hover=ffdfdfdf
DSpopoutButtonBorder_interaction=ff57b9fc
DSpopoutButtonBorder_disabled=ff202020

;4.4
DSconnectionCodeEditor=ff333333
DSconnectionEditorMicroToolbar=ff282828
DSconnectionEditorButtonBackground_hover=ff333333
DSconnectionEditorButtonBorder_hover=ff606060
DSpillText=ffffffff
DSpillTextSelected=ff000000
DspillTextEdit=ffffffff
DSpillDefaultBackgroundIdle=ff343434
DSpillDefaultBackgroundHover=ff4d4d4d
DSpillOperatorBackgroundIdle=ff6b2a7b
DSpillOperatorBackgroundHover=ff7e478b
DSpillLiteralBackgroundIdle=ff447953
DSpillLiteralBackgroundHover=ff61866B

;END NEW FOR QtDS 4

;REMAPPED
DSinteraction=ff57b9fc
DScontrolBackground=ff2a2a2a
DScontrolOutlineInteraction=ff57b9fc
DScontrolOutline=ff1b1b1b
DSiconColorInteraction=ff1b1b1b
DSiconColorSelected=ff1b1b1b
DSsectionHeadBackground=ff333333
DSstateSeparatorColor=ff343434
DSnavigatorItemBackground=ff2a2a2a
DSnavigatorItemBackgroundHover=ff343434
DSnavigatorItemBackgroundSelected=ff333333
DStabActiveBackground=ff4d4d4d
DStabActiveText=ffdcdada
DStabActiveIcon=ffdcdada
DStabFocusButtonHover=ff57b9fc
DStabFocusButtonPress=ff57b9fc
DStabFocusBackground=ff57b9fc
DSnavigatorText=ffdfdfdf
DSpopupBackground=ff202020
DSinteractionHover=ff74CBFC
DSnavigatorTextSelected=ff57b9fc

;contentious remap
;background color for main form view, library, navigator, properties, connections
QmlDesigner_BackgroundColorDarkAlternate=ff2a2a2a

;TODO
DSscrollBarTrack=ff8b8b8b
DSscrollBarHandle=ffbbbbbb
DSscrollBarHandle_idle=ff8d8d8d

DSdockWidgetTitleBar=ff2a2a2a
DSdockWidgetSplitter=ff000000

;LEGACY
DSwelcomeScreenBackground=ff242424
DSsubPanelBackground=ff1c1c1c
DSthumbnailBackground=ff232323
DSthumbnailLabelBackground=ff2b2a2a
DSgreenLight=ff5cdc68
DSamberLight=ffffbf00
DSredLight=ffff0401

DSerrorColor=ffdf3a3a
DSwarningColor=ffecbc1c
DSdisabledColor=ff707070


DScontrolBackgroundInteraction=ff3d3d3d
DScontrolBackgroundDisabled=ff2e2f30
DScontrolBackgroundGlobalHover=ff333333
DScontrolBackgroundHover=ff333333

DScontrolOutlineDisabled=ff707070

DStextColorDisabled=ff707070
DStextSelectionColor=ff2aafd3
DStextSelectedTextColor=ff000000

DSplaceholderTextColor=ffffffff
DSplaceholderTextColorInteraction=ffababab

DSiconColor=ffffffff
DSiconColorHover=ffffffff
DSiconColorDisabled=ffC7C7C7
DSiconColorSelected=ff2aafd3
DSlinkIndicatorColor=ff808080
DSlinkIndicatorColorHover=ffffffff
DSlinkIndicatorColorInteraction=ff2aafd3
DSlinkIndicatorColorDisabled=ff707070


DSpopupOverlayColor=99191919

DSsliderActiveTrack=ff7c7b7b
DSsliderActiveTrackHover=ff000000
DSsliderActiveTrackFocus=ffaaaaaa
DSsliderInactiveTrack=ff595959
DSsliderInactiveTrackHover=ff505050
DSsliderInactiveTrackFocus=ff606060
DSsliderHandle=ff1f1f1f
DSsliderHandleHover=ff606060
DSsliderHandleFocus=ff0492c9
DSsliderHandleInteraction=ff2aafd3

DSstateDefaultHighlight=ffffe400
DSstateBackgroundColor=fffff000
DSstatePreviewOutline=ffaaaaaa

DSstatePanelBackground=ff252525
DSstateHighlight=ff727272

DSchangedStateText=ff99ccff

DS3DAxisXColor=ffd00000
DS3DAxisYColor=ff009900
DS3DAxisZColor=ff5050ff

DSactionBinding=ff2aafd3
DSactionAlias=fff93a3a
DSactionKeyframe=ffe0e01b
DSactionJIT=ff2db543

DStableHeaderBackground=ffff0000
DStableCellCurrent=ff08475B
DStableHeaderText=ff00ff00

DSdockContainerBackground=ff242424
DSdockContainerSplitter=ff323232
DSdockAreaBackground=ff2a2a2a
DSdockWidgetBackground=ff2a2a2a
DStitleBarText=ffdadada
DStitleBarIcon=ffffffff
DStitleBarButtonHover=40ffffff
DStitleBarButtonPress=60ffffff

DStabContainerBackground=ff1f1f1f
DStabSplitter=ff595959

DStabInactiveBackground=ff1f1f1f
DStabInactiveText=ffdadada
DStabInactiveIcon=ffffffff
DStabInactiveButtonHover=ff1f1f1f
DStabInactiveButtonPress=ff1f1f1f

DStabActiveButtonHover=ffdadada
DStabActiveButtonPress=ffdadada

DStabFocusText=ff111111
DStabFocusIcon=ff000000

DSnavigatorBranch=ff7c7b7b
DSnavigatorBranchIndicator=ff7c7b7b
DSnavigatorTextHover=ffffffff

DSnavigatorIcon=ffffffff
DSnavigatorIconHover=ffa1a1a1
DSnavigatorIconSelected=ffffffff
DSnavigatorAliasIconChecked=ffff0000
DSnavigatorDropIndicatorBackground=ff2aafd3
DSnavigatorDropIndicatorOutline=ff2aafd3

DSheaderViewBackground=ff1f1f1f
DStableViewAlternateBackground=ff00ff00

DStoolTipBackground=ff111111
DStoolTipOutline=ffdadada
DStoolTipText=ffdadada

DSUnimportedModuleColor=ffe33c2e

DSBackgroundColorAlternate=ff353637
DSBackgroundColorNormal=ff262728

;DS controls theme END

Navigator_DefaultColor=ffffffff
Navigator_3DColor=ffffbf00
Navigator_2DColor=ff5cdc68
Navigator_MaterialColor=ff2aafd3

QmlDesigner_BackgroundColor=ff4c4e50
QmlDesigner_HighlightColor=ff1d545c
QmlDesigner_FormEditorSelectionColor=ff4ba2ff
QmlDesigner_FormEditorForegroundColor=ffffffff
QmlDesigner_BackgroundColorDarkAlternate=ff2a2a2a
QmlDesigner_BackgroundColorDarker=ff262728
QmlDesigner_BorderColor=ff06080A
QmlDesigner_ButtonColor=ff595b5c
QmlDesigner_TabDark=ff404142
QmlDesigner_TabLight=Token_Text_Default
QmlDesigner_FormeditorBackgroundColor=ff4c4e50
QmlDesigner_AlternateBackgroundColor=ff4c4e50
QmlDesigner_ScrollBarHandleColor=ff595b5c
