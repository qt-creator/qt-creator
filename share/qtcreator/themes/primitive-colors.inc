[Colors]

Primitive-Neutral-000=FFFFFFFF
Primitive-Neutral-100=FFFCFCFC
Primitive-Neutral-150=FFF2F2F2
Primitive-Neutral-200=FFE3E3E3
Primitive-Neutral-250=FFCDCDCD
Primitive-Neutral-300=FFBEBEBE
Primitive-Neutral-350=FFAEAEAE
Primitive-Neutral-400=FF9D9D9D
Primitive-Neutral-450=FF909090
Primitive-Neutral-500=FF737373
Primitive-Neutral-550=FF595959
Primitive-Neutral-600=FF4A4A4A
Primitive-Neutral-650=FF3F3F3F
Primitive-Neutral-700=FF353535
Primitive-Neutral-750=FF2D2D2D
Primitive-Neutral-800=FF262626
Primitive-Neutral-850=FF1F1F1F
Primitive-Neutral-900=FF181818
Primitive-Neutral-950=FF121212
Primitive-Neutral-1000=FF000000

Primitive-Neon-100=FFDBFDEC
Primitive-Neon-200=FFB9F9D9
Primitive-Neon-300=FF83F2BA
Primitive-Neon-400=FF2CDE85
Primitive-Neon-500=FF27BF73
Primitive-Neon-600=FF1F9B5D
Primitive-Neon-700=FF12834B
Primitive-Neon-800=FF14673E
Primitive-Neon-900=FF13432B
Primitive-Neon-1000=FF133122

Primitive-Red-100=FFFACED9
Primitive-Red-200=FFF0A4B7
Primitive-Red-300=FFEA718E
Primitive-Red-400=FFE34269
Primitive-Red-500=FFDC1343
Primitive-Red-600=FFB00F36
Primitive-Red-700=FF840B28
Primitive-Red-800=FF561020
Primitive-Red-900=FF411721
Primitive-Red-1000=FF33161C

Primitive-Pine-100=FFE1F4FD
Primitive-Pine-200=FFBCEAFB
Primitive-Pine-300=FF80DBF9
Primitive-Pine-400=FF3CC8F4
Primitive-Pine-500=FF13B2E4
Primitive-Pine-600=FF0690C3
Primitive-Pine-700=FF077497
Primitive-Pine-800=FF0A6078
Primitive-Pine-900=FF0E4E5F
Primitive-Pine-1000=FF00414A

Primitive-Yellow-100=FFFFEBCD
Primitive-Yellow-200=FFF7D6A5
Primitive-Yellow-300=FFF3C279
Primitive-Yellow-400=FFEFAD4C
Primitive-Yellow-500=FFEB991F
Primitive-Yellow-600=FFBC7A19
Primitive-Yellow-700=FF8D5C13
Primitive-Yellow-800=FF5E3D0C
Primitive-Yellow-900=FF3F2C11
Primitive-Yellow-1000=FF31240F

Primitive-Blue-100=FFD9D2F9
Primitive-Blue-200=FFB7ABF4
Primitive-Blue-300=FF8671EC
Primitive-Blue-400=FF654FD4
Primitive-Blue-500=FF4530B0
Primitive-Blue-600=FF361EAB
Primitive-Blue-700=FF27138B
Primitive-Blue-800=FF241570
Primitive-Blue-900=FF1E1450
Primitive-Blue-1000=FF18123A
