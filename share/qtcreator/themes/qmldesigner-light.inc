[General]
Includes=ds.tokenmapping

[Colors]
;DS controls theme START

;NEW FOR QtDS 4
;4.0
DScontrolBackground_toolbarIdle=ffdcdada
DScontrolBackground_toolbarHover=ffdcdada
DScontrolBackground_topToolbarHover=ffbbbbbb
DScontrolBackground_statusbarIdle=ffbbbbbb
DSControlBackground_statusbarHover=ffdfdfdf
DScontrolOutline_topToolbarIdle=ffbbbbbb
DScontrolOutline_topToolbarHover=ffdfdfdf
DSidleGreen=ff649a5d
DSrunningGreen=ff2eff68
DStoolbarBackground=ffdcdada
DStoolbarIcon_blocked=ff636363
DSthumbnailBackground_baseState=ff8b8b8b
DStextColor=ff4d4d4d
DSstatusbarBackground=ffbbbbbb
DSprimaryButton_hoverHighlight=ff74CBFC
DSstateBackgroundColor_hover=ffbbbbbb
DSstateControlBackgroundColor_globalHover=ffbbbbbb
DSstateControlBackgroundColor_hover=ff8b8b8b
DSpanelBackground=ff2a2a2a

;4.3
DSpopoutBackground=ffdcdada
DSpopoutControlBackground_idle=ffdcdada
DSpopoutControlBackground_hover=ffdfdfdf
DSpopoutControlBackground_globalHover=ffdfdfdf
DSpopoutControlBackground_interaction=ff57b9fc
DSpopoutControlBackground_disabled=ffdcdada
DSpopoutPopupBackground=ffdfdfdf

DSpopoutControlBorder_idle=ff8d8d8d
DSpopoutControlBorder_hover=ffbbbbbb
DSpopoutControlBorder_interaction=ff57b9fc
DSpopoutControlBorder_disabled=ffdcdada

DSpopoutButtonBackground_idle=ffdcdada
DSpopoutButtonBackground_hover=ffdfdfdf
DSpopoutButtonBackground_interaction=ff57b9fc
DSpopoutButtonBackground_disabled=ffdcdada

DSpopoutButtonBorder_idle=ff8b8b8b
DSpopoutButtonBorder_hover=ff636363
DSpopoutButtonBorder_interaction=ff57b9fc
DSpopoutButtonBorder_disabled=ffdcdada

;4.4
DSconnectionCodeEditor=ffdfdfdf
DSconnectionEditorMicroToolbar=ffbbbbbb
DSconnectionEditorButtonBackground_hover=ffdfdfdf
DSconnectionEditorButtonBorder_hover=ff606060
DSpillText=ffffffff
DSpillTextSelected=ff000000
DspillTextEdit=ff000000
DSpillDefaultBackgroundIdle=ff636363
DSpillDefaultBackgroundHover=ff8b8b8b
DSpillOperatorBackgroundIdle=ff6b2a7b
DSpillOperatorBackgroundHover=ff7e478b
DSpillLiteralBackgroundIdle=ff447953
DSpillLiteralBackgroundHover=ff61866B

;END NEW FOR QtDS 4

DSpanelBackground=ffeaeaea

DSwelcomeScreenBackground=ffEAEAEA
DSsubPanelBackground=ffEFEFEF
DSthumbnailBackground=ffE8E8E8
DSthumbnailLabelBackground=ffDDDDDD

DSgreenLight=ff5cdc68
DSamberLight=ffffbf00
DSredLight=ffff0401

DSinteraction=ff57b9fc
DSerrorColor=ffdf3a3a
DSwarningColor=ffecbc1c
DSdisabledColor=ff8e8e8e

DSinteractionHover=ff74CBFC

DScontrolBackground=ffeaeaea
DScontrolBackgroundInteraction=ffc9c9c9
DScontrolBackgroundDisabled=ffeaeaea
DScontrolBackgroundGlobalHover=ffdedddd
DScontrolBackgroundHover=ffdedddd

DScontrolOutline=ffcecccc
DScontrolOutlineInteraction=ff2aafd3
DScontrolOutlineDisabled=ff707070

DStextColorDisabled=ff707070
DStextSelectionColor=ff2aafd3
DStextSelectedTextColor=ff000000

DSplaceholderTextColor=ff262626
DSplaceholderTextColorInteraction=ffababab

DSiconColor=ff262626
DSiconColorHover=ff191919
DSiconColorInteraction=ffffffff
DSiconColorDisabled=ff707070
DSiconColorSelected=ff2aafd3

DSlinkIndicatorColor=ff808080
DSlinkIndicatorColorHover=ff1f1f1f
DSlinkIndicatorColorInteraction=ff2aafd3
DSlinkIndicatorColorDisabled=ff707070

DSpopupBackground=ffd3d3d3
DSpopupOverlayColor=99191919

DSsliderActiveTrack=ff7c7b7b
DSsliderActiveTrackHover=ff000000
DSsliderActiveTrackFocus=ffaaaaaa
DSsliderInactiveTrack=ffaaaaaa
DSsliderInactiveTrackHover=ff505050
DSsliderInactiveTrackFocus=ff606060
DSsliderHandle=ff1f1f1f
DSsliderHandleHover=ff606060
DSsliderHandleFocus=ff0492c9
DSsliderHandleInteraction=ff2aafd3

DSscrollBarTrack=ff8b8b8b
DSscrollBarHandle=ff636363
DSscrollBarHandle_idle=ff8d8d8d

DSsectionHeadBackground=ffd8d8d8

DSstateDefaultHighlight=ffffe400
DSstateSeparatorColor=ffadadad
DSstateBackgroundColor=ffe0e0e0
DSstatePreviewOutline=ff363636

DSstatePanelBackground=ffdadada
DSstateHighlight=ff8d8d8d

DSchangedStateText=ff99ccff

DS3DAxisXColor=ffd00000
DS3DAxisYColor=ff009900
DS3DAxisZColor=ff5050ff

DSactionBinding=ff2aafd3
DSactionAlias=fff93a3a
DSactionKeyframe=ffe0e01b
DSactionJIT=ff2db543

DStableHeaderBackground=ffff0000
DStableCellCurrent=ff71d1ef
DStableHeaderText=ff00ff00

DSdockContainerBackground=ff323232
DSdockContainerSplitter=ff323232
DSdockAreaBackground=ffeaeaea
DSdockWidgetBackground=ffeaeaea
DSdockWidgetSplitter=ff595959
DSdockWidgetTitleBar=ffeaeaea

DStitleBarText=ffdadada
DStitleBarIcon=ff4f5052
DStitleBarButtonHover=40ffffff
DStitleBarButtonPress=60ffffff

DStabContainerBackground=ffdadada
DStabSplitter=ff595959

DStabInactiveBackground=ff999999
DStabInactiveText=ff262626
DStabInactiveIcon=ffffffff
DStabInactiveButtonHover=ff1f1f1f
DStabInactiveButtonPress=ff1f1f1f

DStabActiveBackground=ffdadada
DStabActiveText=ff111111
DStabActiveIcon=ff000000
DStabActiveButtonHover=ffdadada
DStabActiveButtonPress=ffdadada

DStabFocusBackground=ff2aafd3
DStabFocusText=ff111111
DStabFocusIcon=ff000000
DStabFocusButtonHover=ff2aafd3
DStabFocusButtonPress=ff2aafd3

DSnavigatorBranch=ff7c7b7b
DSnavigatorBranchIndicator=ff7c7b7b
DSnavigatorItemBackground=ffeaeaea
DSnavigatorItemBackgroundHover=ffdedddd
DSnavigatorItemBackgroundSelected=ffffffff
DSnavigatorText=ff262626
DSnavigatorTextHover=ff1f1f1f
DSnavigatorTextSelected=ff2aafd3
DSnavigatorIcon=ff1f1f1f
DSnavigatorIconHover=ff7c7b7b
DSnavigatorIconSelected=ff1f1f1f
DSnavigatorAliasIconChecked=ffff0000
DSnavigatorDropIndicatorBackground=ff2aafd3
DSnavigatorDropIndicatorOutline=ff2aafd3

DSheaderViewBackground=ffd8d8d8
DStableViewAlternateBackground=ff00ff00

DStoolTipBackground=ff111111
DStoolTipOutline=ffdadada
DStoolTipText=ffdadada

DSUnimportedModuleColor=ffe33c2e

DSBackgroundColorAlternate=ffeaeaea
DSBackgroundColorNormal=ffd8d8d8

;DS controls theme END

Navigator_DefaultColor=ffffffff
Navigator_3DColor=ffffbf00
Navigator_2DColor=ff5cdc68
Navigator_MaterialColor=ff2aafd3

QmlDesigner_BackgroundColor=fff8f8f8
QmlDesigner_HighlightColor=ff46a2da
QmlDesigner_FormEditorSelectionColor=ff4ba2ff
QmlDesigner_FormEditorForegroundColor=ffffffff
QmlDesigner_BackgroundColorDarkAlternate=ffeaeaea
QmlDesigner_BackgroundColorDarker=fff5f5f5
QmlDesigner_BorderColor=ffbdbebf
QmlDesigner_ButtonColor=ffcccccc
QmlDesigner_TabDark=ff585858
QmlDesigner_TabLight=ffd0d0d0
QmlDesigner_FormeditorBackgroundColor=fff8f8f8
QmlDesigner_AlternateBackgroundColor=fff8f8f8
QmlDesigner_ScrollBarHandleColor=ffcccccc
